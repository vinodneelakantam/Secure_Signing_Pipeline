## yocto/meta-can-utils-secure/conf/layer.conf
```bitbake
BBPATH .= ":${LAYERDIR}"
BBFILES += "${LAYERDIR}/recipes-*/*/*.bb"
BBFILE_COLLECTIONS += "can-utils-secure"
BBFILE_PATTERN_can-utils-secure = "^${LAYERDIR}/"
BBFILE_PRIORITY_can-utils-secure = "9"
```

## yocto/meta-mosquitto-secure/conf/layer.conf
```bitbake
BBPATH .= ":${LAYERDIR}"
BBFILES += "${LAYERDIR}/recipes-*/*/*.bb"
BBFILE_COLLECTIONS += "mosquitto-secure"
BBFILE_PATTERN_mosquitto-secure = "^${LAYERDIR}/"
BBFILE_PRIORITY_mosquitto-secure = "9"
```

## yocto/meta-secure-signing/conf/layer.conf
```bitbake
BBPATH .= ":${LAYERDIR}"
BBFILES += "${LAYERDIR}/recipes-*/*/*.bb ${LAYERDIR}/recipes-*/*/*.bbappend"
BBFILE_COLLECTIONS += "secure-signing"
BBFILE_PATTERN_secure-signing = "^${LAYERDIR}/"
BBFILE_PRIORITY_secure-signing = "8"
```

## yocto/meta-uboot-secure/conf/layer.conf
```bitbake
BBPATH .= ":${LAYERDIR}"
BBFILES += "${LAYERDIR}/recipes-*/*/*.bbappend"
BBFILE_COLLECTIONS += "uboot-secure"
BBFILE_PATTERN_uboot-secure = "^${LAYERDIR}/"
BBFILE_PRIORITY_uboot-secure = "9"
```

## yocto/meta-wireguard-secure/conf/layer.conf
```bitbake
BBPATH .= ":${LAYERDIR}"
BBFILES += "${LAYERDIR}/recipes-*/*/*.bb"
BBFILE_COLLECTIONS += "wireguard-secure"
BBFILE_PATTERN_wireguard-secure = "^${LAYERDIR}/"
BBFILE_PRIORITY_wireguard-secure = "9"
```
